/ {
    fragment {
            target-path = "/";
            __overlay__ {

			bat: battery {
				compatible = "simple-battery";
				charge-full-design-microamp-hours = <4901000>;
				charge-term-current-microamp = <240000>;
				constant_charge_voltage_max_microvolt = <4435000>;
				factory-internal-resistance-micro-ohms = <128000>;
				voltage-min-design-microvolt = <3450000>;
				ocv-capacity-celsius = <20>;
				ocv-capacity-table-0 = <4381000 100>, <4325000 95>, <4268000 90>,
							<4211000 85>, <4154000 80>, <4100000 75>,
							<4049000 70>, <4001000 65>, <3951000 60>,
							<3898000 55>, <3866000 50>, <3840000 45>,
							<3819000 40>, <3802000 35>, <3786000 30>,
							<3765000 25>, <3744000 20>, <3720000 15>,
							<3691000 10>, <3679000 5>, <3400000 0>;
				voltage-temp-table = <1307738 700>, <1203814 750>, <1095466 800>,
							<986111 850>, <878558 900>, <775112 950>,
							<678460 1000>, <590240 1050>, <510772 1100>,
							<440156 1150>, <378279 1200>, <324561 1250>,
							<278079 1300>, <238259 1350>, <204266 1400>,
							<175208 1450>, <150459 1500>, <129410 1550>,
							<111497 1600>, <96484 1650>, <81275 1700>,
							<72771 1750>, <63423 1800>, <55444 1850>,
							<48599 1900>, <42668 1950>, <37552 2000>;
				capacity-temp-table =<45 100>, <25 100>, <10 99>, <0 91>, <(-10) 86>, <(-20) 64>;
				resistance-temp-table =<45 100>, <25 100>, <10 225>, <0 919>, <(-10) 981>, <(-20) 1097>;
				charge-sdp-current-microamp = <500000 2000000>;
				charge-dcp-current-microamp = <2100000 2200000>;
				charge-cdp-current-microamp = <1500000 2100000>;
				charge-unknown-current-microamp = <2100000 2100000>;
			};
        };
    };
};

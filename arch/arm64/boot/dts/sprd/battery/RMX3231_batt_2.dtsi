/ {
    fragment {
            target-path = "/";
            __overlay__ {

			bat2: battery2 {
				compatible = "simple-battery";
				charge-full-design-microamp-hours = <4732000>;
				charge-term-current-microamp = <240000>;
				constant_charge_voltage_max_microvolt = <4435000>;
				factory-internal-resistance-micro-ohms = <123000>;
				voltage-min-design-microvolt = <3450000>;
				ocv-capacity-celsius = <20>;
				ocv-capacity-table-0 = <4376000 100>, <4324000 95>, <4269000 90>,
							<4211000 85>, <4154000 80>, <4100000 75>,
							<4049000 70>, <4003000 65>, <3950000 60>,
							<3897000 55>, <3865000 50>, <3839000 45>,
							<3817000 40>, <3800000 35>, <3780000 30>,
							<3752000 25>, <3731000 20>, <3706000 15>,
							<3681000 10>, <3668000 5>, <3400000 0>;
				voltage-temp-table = <1307738 700>, <1203814 750>, <1095466 800>,
							<986111 850>, <878558 900>, <775112 950>,
							<678460 1000>, <590240 1050>, <510772 1100>,
							<440156 1150>, <378279 1200>, <324561 1250>,
							<278079 1300>, <238259 1350>, <204266 1400>,
							<175208 1450>, <150459 1500>, <129410 1550>,
							<111497 1600>, <96484 1650>, <81275 1700>,
							<72771 1750>, <63423 1800>, <55444 1850>,
							<48599 1900>, <42668 1950>, <37552 2000>;
				capacity-temp-table =<45 100>, <25 100>, <10 100>, <0 90>, <(-10) 87>, <(-20) 73>;
				resistance-temp-table =<45 100>, <25 100>, <10 153>, <0 933>, <(-10) 1016>, <(-20) 1112>;
				charge-sdp-current-microamp = <500000 2000000>;
				charge-dcp-current-microamp = <2100000 2200000>;
				charge-cdp-current-microamp = <1500000 2100000>;
				charge-unknown-current-microamp = <2100000 2100000>;
			};
        };
    };
};
